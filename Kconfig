## Kconfig
```kconfig
# SPDX-License-Identifier: MIT
config ZMK_BEHAVIOR_SOFLE_ENCODER_KEY
    bool
    default y
    depends on DT_HAS_ZMK_BEHAVIOR_SOFLE_ENCODER_KEY_ENABLED
    depends on !ZMK_SPLIT || ZMK_SPLIT_ROLE_CENTRAL
```

## dts/bindings/behaviors/zmk,behavior-sofle-encoder-key.yaml
```yaml
# SPDX-License-Identifier: MIT
description: Route an encoder tap through a Studio-editable key position
compatible: "zmk,behavior-sofle-encoder-key"
include: one_param.yaml
```
